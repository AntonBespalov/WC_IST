VERSION "Draft 0.2 (skeleton)"

NS_ :

BS_:

BU_: TK SRC

CM_ "DBC-скелет для удобного сниффинга/декодирования. Сейчас поля протокола не имеют зафиксированной байтовой раскладки в `docs/protocols/PROTOCOL_TK.md`, поэтому здесь временно описаны только сырые байты payload (b00..b63). Когда раскладка будет зафиксирована, заменить байтовые сигналы на реальные (I_ref_cmd, seq, state, ...).";

BO_ 16 FAULT: 64 SRC
 SG_ b00 : 0|8@1+ (1,0) [0|255] ""  TK
 SG_ b01 : 8|8@1+ (1,0) [0|255] ""  TK
 SG_ b02 : 16|8@1+ (1,0) [0|255] ""  TK
 SG_ b03 : 24|8@1+ (1,0) [0|255] ""  TK
 SG_ b04 : 32|8@1+ (1,0) [0|255] ""  TK
 SG_ b05 : 40|8@1+ (1,0) [0|255] ""  TK
 SG_ b06 : 48|8@1+ (1,0) [0|255] ""  TK
 SG_ b07 : 56|8@1+ (1,0) [0|255] ""  TK
 SG_ b08 : 64|8@1+ (1,0) [0|255] ""  TK
 SG_ b09 : 72|8@1+ (1,0) [0|255] ""  TK
 SG_ b10 : 80|8@1+ (1,0) [0|255] ""  TK
 SG_ b11 : 88|8@1+ (1,0) [0|255] ""  TK
 SG_ b12 : 96|8@1+ (1,0) [0|255] ""  TK
 SG_ b13 : 104|8@1+ (1,0) [0|255] ""  TK
 SG_ b14 : 112|8@1+ (1,0) [0|255] ""  TK
 SG_ b15 : 120|8@1+ (1,0) [0|255] ""  TK
 SG_ b16 : 128|8@1+ (1,0) [0|255] ""  TK
 SG_ b17 : 136|8@1+ (1,0) [0|255] ""  TK
 SG_ b18 : 144|8@1+ (1,0) [0|255] ""  TK
 SG_ b19 : 152|8@1+ (1,0) [0|255] ""  TK
 SG_ b20 : 160|8@1+ (1,0) [0|255] ""  TK
 SG_ b21 : 168|8@1+ (1,0) [0|255] ""  TK
 SG_ b22 : 176|8@1+ (1,0) [0|255] ""  TK
 SG_ b23 : 184|8@1+ (1,0) [0|255] ""  TK
 SG_ b24 : 192|8@1+ (1,0) [0|255] ""  TK
 SG_ b25 : 200|8@1+ (1,0) [0|255] ""  TK
 SG_ b26 : 208|8@1+ (1,0) [0|255] ""  TK
 SG_ b27 : 216|8@1+ (1,0) [0|255] ""  TK
 SG_ b28 : 224|8@1+ (1,0) [0|255] ""  TK
 SG_ b29 : 232|8@1+ (1,0) [0|255] ""  TK
 SG_ b30 : 240|8@1+ (1,0) [0|255] ""  TK
 SG_ b31 : 248|8@1+ (1,0) [0|255] ""  TK
 SG_ b32 : 256|8@1+ (1,0) [0|255] ""  TK
 SG_ b33 : 264|8@1+ (1,0) [0|255] ""  TK
 SG_ b34 : 272|8@1+ (1,0) [0|255] ""  TK
 SG_ b35 : 280|8@1+ (1,0) [0|255] ""  TK
 SG_ b36 : 288|8@1+ (1,0) [0|255] ""  TK
 SG_ b37 : 296|8@1+ (1,0) [0|255] ""  TK
 SG_ b38 : 304|8@1+ (1,0) [0|255] ""  TK
 SG_ b39 : 312|8@1+ (1,0) [0|255] ""  TK
 SG_ b40 : 320|8@1+ (1,0) [0|255] ""  TK
 SG_ b41 : 328|8@1+ (1,0) [0|255] ""  TK
 SG_ b42 : 336|8@1+ (1,0) [0|255] ""  TK
 SG_ b43 : 344|8@1+ (1,0) [0|255] ""  TK
 SG_ b44 : 352|8@1+ (1,0) [0|255] ""  TK
 SG_ b45 : 360|8@1+ (1,0) [0|255] ""  TK
 SG_ b46 : 368|8@1+ (1,0) [0|255] ""  TK
 SG_ b47 : 376|8@1+ (1,0) [0|255] ""  TK
 SG_ b48 : 384|8@1+ (1,0) [0|255] ""  TK
 SG_ b49 : 392|8@1+ (1,0) [0|255] ""  TK
 SG_ b50 : 400|8@1+ (1,0) [0|255] ""  TK
 SG_ b51 : 408|8@1+ (1,0) [0|255] ""  TK
 SG_ b52 : 416|8@1+ (1,0) [0|255] ""  TK
 SG_ b53 : 424|8@1+ (1,0) [0|255] ""  TK
 SG_ b54 : 432|8@1+ (1,0) [0|255] ""  TK
 SG_ b55 : 440|8@1+ (1,0) [0|255] ""  TK
 SG_ b56 : 448|8@1+ (1,0) [0|255] ""  TK
 SG_ b57 : 456|8@1+ (1,0) [0|255] ""  TK
 SG_ b58 : 464|8@1+ (1,0) [0|255] ""  TK
 SG_ b59 : 472|8@1+ (1,0) [0|255] ""  TK
 SG_ b60 : 480|8@1+ (1,0) [0|255] ""  TK
 SG_ b61 : 488|8@1+ (1,0) [0|255] ""  TK
 SG_ b62 : 496|8@1+ (1,0) [0|255] ""  TK
 SG_ b63 : 504|8@1+ (1,0) [0|255] ""  TK

BO_ 32 CMD_WELD: 64 TK
 SG_ b00 : 0|8@1+ (1,0) [0|255] ""  SRC
 SG_ b01 : 8|8@1+ (1,0) [0|255] ""  SRC
 SG_ b02 : 16|8@1+ (1,0) [0|255] ""  SRC
 SG_ b03 : 24|8@1+ (1,0) [0|255] ""  SRC
 SG_ b04 : 32|8@1+ (1,0) [0|255] ""  SRC
 SG_ b05 : 40|8@1+ (1,0) [0|255] ""  SRC
 SG_ b06 : 48|8@1+ (1,0) [0|255] ""  SRC
 SG_ b07 : 56|8@1+ (1,0) [0|255] ""  SRC
 SG_ b08 : 64|8@1+ (1,0) [0|255] ""  SRC
 SG_ b09 : 72|8@1+ (1,0) [0|255] ""  SRC
 SG_ b10 : 80|8@1+ (1,0) [0|255] ""  SRC
 SG_ b11 : 88|8@1+ (1,0) [0|255] ""  SRC
 SG_ b12 : 96|8@1+ (1,0) [0|255] ""  SRC
 SG_ b13 : 104|8@1+ (1,0) [0|255] ""  SRC
 SG_ b14 : 112|8@1+ (1,0) [0|255] ""  SRC
 SG_ b15 : 120|8@1+ (1,0) [0|255] ""  SRC
 SG_ b16 : 128|8@1+ (1,0) [0|255] ""  SRC
 SG_ b17 : 136|8@1+ (1,0) [0|255] ""  SRC
 SG_ b18 : 144|8@1+ (1,0) [0|255] ""  SRC
 SG_ b19 : 152|8@1+ (1,0) [0|255] ""  SRC
 SG_ b20 : 160|8@1+ (1,0) [0|255] ""  SRC
 SG_ b21 : 168|8@1+ (1,0) [0|255] ""  SRC
 SG_ b22 : 176|8@1+ (1,0) [0|255] ""  SRC
 SG_ b23 : 184|8@1+ (1,0) [0|255] ""  SRC
 SG_ b24 : 192|8@1+ (1,0) [0|255] ""  SRC
 SG_ b25 : 200|8@1+ (1,0) [0|255] ""  SRC
 SG_ b26 : 208|8@1+ (1,0) [0|255] ""  SRC
 SG_ b27 : 216|8@1+ (1,0) [0|255] ""  SRC
 SG_ b28 : 224|8@1+ (1,0) [0|255] ""  SRC
 SG_ b29 : 232|8@1+ (1,0) [0|255] ""  SRC
 SG_ b30 : 240|8@1+ (1,0) [0|255] ""  SRC
 SG_ b31 : 248|8@1+ (1,0) [0|255] ""  SRC
 SG_ b32 : 256|8@1+ (1,0) [0|255] ""  SRC
 SG_ b33 : 264|8@1+ (1,0) [0|255] ""  SRC
 SG_ b34 : 272|8@1+ (1,0) [0|255] ""  SRC
 SG_ b35 : 280|8@1+ (1,0) [0|255] ""  SRC
 SG_ b36 : 288|8@1+ (1,0) [0|255] ""  SRC
 SG_ b37 : 296|8@1+ (1,0) [0|255] ""  SRC
 SG_ b38 : 304|8@1+ (1,0) [0|255] ""  SRC
 SG_ b39 : 312|8@1+ (1,0) [0|255] ""  SRC
 SG_ b40 : 320|8@1+ (1,0) [0|255] ""  SRC
 SG_ b41 : 328|8@1+ (1,0) [0|255] ""  SRC
 SG_ b42 : 336|8@1+ (1,0) [0|255] ""  SRC
 SG_ b43 : 344|8@1+ (1,0) [0|255] ""  SRC
 SG_ b44 : 352|8@1+ (1,0) [0|255] ""  SRC
 SG_ b45 : 360|8@1+ (1,0) [0|255] ""  SRC
 SG_ b46 : 368|8@1+ (1,0) [0|255] ""  SRC
 SG_ b47 : 376|8@1+ (1,0) [0|255] ""  SRC
 SG_ b48 : 384|8@1+ (1,0) [0|255] ""  SRC
 SG_ b49 : 392|8@1+ (1,0) [0|255] ""  SRC
 SG_ b50 : 400|8@1+ (1,0) [0|255] ""  SRC
 SG_ b51 : 408|8@1+ (1,0) [0|255] ""  SRC
 SG_ b52 : 416|8@1+ (1,0) [0|255] ""  SRC
 SG_ b53 : 424|8@1+ (1,0) [0|255] ""  SRC
 SG_ b54 : 432|8@1+ (1,0) [0|255] ""  SRC
 SG_ b55 : 440|8@1+ (1,0) [0|255] ""  SRC
 SG_ b56 : 448|8@1+ (1,0) [0|255] ""  SRC
 SG_ b57 : 456|8@1+ (1,0) [0|255] ""  SRC
 SG_ b58 : 464|8@1+ (1,0) [0|255] ""  SRC
 SG_ b59 : 472|8@1+ (1,0) [0|255] ""  SRC
 SG_ b60 : 480|8@1+ (1,0) [0|255] ""  SRC
 SG_ b61 : 488|8@1+ (1,0) [0|255] ""  SRC
 SG_ b62 : 496|8@1+ (1,0) [0|255] ""  SRC
 SG_ b63 : 504|8@1+ (1,0) [0|255] ""  SRC

BO_ 48 FB_STATUS: 64 SRC
 SG_ b00 : 0|8@1+ (1,0) [0|255] ""  TK
 SG_ b01 : 8|8@1+ (1,0) [0|255] ""  TK
 SG_ b02 : 16|8@1+ (1,0) [0|255] ""  TK
 SG_ b03 : 24|8@1+ (1,0) [0|255] ""  TK
 SG_ b04 : 32|8@1+ (1,0) [0|255] ""  TK
 SG_ b05 : 40|8@1+ (1,0) [0|255] ""  TK
 SG_ b06 : 48|8@1+ (1,0) [0|255] ""  TK
 SG_ b07 : 56|8@1+ (1,0) [0|255] ""  TK
 SG_ b08 : 64|8@1+ (1,0) [0|255] ""  TK
 SG_ b09 : 72|8@1+ (1,0) [0|255] ""  TK
 SG_ b10 : 80|8@1+ (1,0) [0|255] ""  TK
 SG_ b11 : 88|8@1+ (1,0) [0|255] ""  TK
 SG_ b12 : 96|8@1+ (1,0) [0|255] ""  TK
 SG_ b13 : 104|8@1+ (1,0) [0|255] ""  TK
 SG_ b14 : 112|8@1+ (1,0) [0|255] ""  TK
 SG_ b15 : 120|8@1+ (1,0) [0|255] ""  TK
 SG_ b16 : 128|8@1+ (1,0) [0|255] ""  TK
 SG_ b17 : 136|8@1+ (1,0) [0|255] ""  TK
 SG_ b18 : 144|8@1+ (1,0) [0|255] ""  TK
 SG_ b19 : 152|8@1+ (1,0) [0|255] ""  TK
 SG_ b20 : 160|8@1+ (1,0) [0|255] ""  TK
 SG_ b21 : 168|8@1+ (1,0) [0|255] ""  TK
 SG_ b22 : 176|8@1+ (1,0) [0|255] ""  TK
 SG_ b23 : 184|8@1+ (1,0) [0|255] ""  TK
 SG_ b24 : 192|8@1+ (1,0) [0|255] ""  TK
 SG_ b25 : 200|8@1+ (1,0) [0|255] ""  TK
 SG_ b26 : 208|8@1+ (1,0) [0|255] ""  TK
 SG_ b27 : 216|8@1+ (1,0) [0|255] ""  TK
 SG_ b28 : 224|8@1+ (1,0) [0|255] ""  TK
 SG_ b29 : 232|8@1+ (1,0) [0|255] ""  TK
 SG_ b30 : 240|8@1+ (1,0) [0|255] ""  TK
 SG_ b31 : 248|8@1+ (1,0) [0|255] ""  TK
 SG_ b32 : 256|8@1+ (1,0) [0|255] ""  TK
 SG_ b33 : 264|8@1+ (1,0) [0|255] ""  TK
 SG_ b34 : 272|8@1+ (1,0) [0|255] ""  TK
 SG_ b35 : 280|8@1+ (1,0) [0|255] ""  TK
 SG_ b36 : 288|8@1+ (1,0) [0|255] ""  TK
 SG_ b37 : 296|8@1+ (1,0) [0|255] ""  TK
 SG_ b38 : 304|8@1+ (1,0) [0|255] ""  TK
 SG_ b39 : 312|8@1+ (1,0) [0|255] ""  TK
 SG_ b40 : 320|8@1+ (1,0) [0|255] ""  TK
 SG_ b41 : 328|8@1+ (1,0) [0|255] ""  TK
 SG_ b42 : 336|8@1+ (1,0) [0|255] ""  TK
 SG_ b43 : 344|8@1+ (1,0) [0|255] ""  TK
 SG_ b44 : 352|8@1+ (1,0) [0|255] ""  TK
 SG_ b45 : 360|8@1+ (1,0) [0|255] ""  TK
 SG_ b46 : 368|8@1+ (1,0) [0|255] ""  TK
 SG_ b47 : 376|8@1+ (1,0) [0|255] ""  TK
 SG_ b48 : 384|8@1+ (1,0) [0|255] ""  TK
 SG_ b49 : 392|8@1+ (1,0) [0|255] ""  TK
 SG_ b50 : 400|8@1+ (1,0) [0|255] ""  TK
 SG_ b51 : 408|8@1+ (1,0) [0|255] ""  TK
 SG_ b52 : 416|8@1+ (1,0) [0|255] ""  TK
 SG_ b53 : 424|8@1+ (1,0) [0|255] ""  TK
 SG_ b54 : 432|8@1+ (1,0) [0|255] ""  TK
 SG_ b55 : 440|8@1+ (1,0) [0|255] ""  TK
 SG_ b56 : 448|8@1+ (1,0) [0|255] ""  TK
 SG_ b57 : 456|8@1+ (1,0) [0|255] ""  TK
 SG_ b58 : 464|8@1+ (1,0) [0|255] ""  TK
 SG_ b59 : 472|8@1+ (1,0) [0|255] ""  TK
 SG_ b60 : 480|8@1+ (1,0) [0|255] ""  TK
 SG_ b61 : 488|8@1+ (1,0) [0|255] ""  TK
 SG_ b62 : 496|8@1+ (1,0) [0|255] ""  TK
 SG_ b63 : 504|8@1+ (1,0) [0|255] ""  TK

BO_ 96 SERVICE_REQ: 64 TK
 SG_ b00 : 0|8@1+ (1,0) [0|255] ""  SRC
 SG_ b01 : 8|8@1+ (1,0) [0|255] ""  SRC
 SG_ b02 : 16|8@1+ (1,0) [0|255] ""  SRC
 SG_ b03 : 24|8@1+ (1,0) [0|255] ""  SRC
 SG_ b04 : 32|8@1+ (1,0) [0|255] ""  SRC
 SG_ b05 : 40|8@1+ (1,0) [0|255] ""  SRC
 SG_ b06 : 48|8@1+ (1,0) [0|255] ""  SRC
 SG_ b07 : 56|8@1+ (1,0) [0|255] ""  SRC
 SG_ b08 : 64|8@1+ (1,0) [0|255] ""  SRC
 SG_ b09 : 72|8@1+ (1,0) [0|255] ""  SRC
 SG_ b10 : 80|8@1+ (1,0) [0|255] ""  SRC
 SG_ b11 : 88|8@1+ (1,0) [0|255] ""  SRC
 SG_ b12 : 96|8@1+ (1,0) [0|255] ""  SRC
 SG_ b13 : 104|8@1+ (1,0) [0|255] ""  SRC
 SG_ b14 : 112|8@1+ (1,0) [0|255] ""  SRC
 SG_ b15 : 120|8@1+ (1,0) [0|255] ""  SRC
 SG_ b16 : 128|8@1+ (1,0) [0|255] ""  SRC
 SG_ b17 : 136|8@1+ (1,0) [0|255] ""  SRC
 SG_ b18 : 144|8@1+ (1,0) [0|255] ""  SRC
 SG_ b19 : 152|8@1+ (1,0) [0|255] ""  SRC
 SG_ b20 : 160|8@1+ (1,0) [0|255] ""  SRC
 SG_ b21 : 168|8@1+ (1,0) [0|255] ""  SRC
 SG_ b22 : 176|8@1+ (1,0) [0|255] ""  SRC
 SG_ b23 : 184|8@1+ (1,0) [0|255] ""  SRC
 SG_ b24 : 192|8@1+ (1,0) [0|255] ""  SRC
 SG_ b25 : 200|8@1+ (1,0) [0|255] ""  SRC
 SG_ b26 : 208|8@1+ (1,0) [0|255] ""  SRC
 SG_ b27 : 216|8@1+ (1,0) [0|255] ""  SRC
 SG_ b28 : 224|8@1+ (1,0) [0|255] ""  SRC
 SG_ b29 : 232|8@1+ (1,0) [0|255] ""  SRC
 SG_ b30 : 240|8@1+ (1,0) [0|255] ""  SRC
 SG_ b31 : 248|8@1+ (1,0) [0|255] ""  SRC
 SG_ b32 : 256|8@1+ (1,0) [0|255] ""  SRC
 SG_ b33 : 264|8@1+ (1,0) [0|255] ""  SRC
 SG_ b34 : 272|8@1+ (1,0) [0|255] ""  SRC
 SG_ b35 : 280|8@1+ (1,0) [0|255] ""  SRC
 SG_ b36 : 288|8@1+ (1,0) [0|255] ""  SRC
 SG_ b37 : 296|8@1+ (1,0) [0|255] ""  SRC
 SG_ b38 : 304|8@1+ (1,0) [0|255] ""  SRC
 SG_ b39 : 312|8@1+ (1,0) [0|255] ""  SRC
 SG_ b40 : 320|8@1+ (1,0) [0|255] ""  SRC
 SG_ b41 : 328|8@1+ (1,0) [0|255] ""  SRC
 SG_ b42 : 336|8@1+ (1,0) [0|255] ""  SRC
 SG_ b43 : 344|8@1+ (1,0) [0|255] ""  SRC
 SG_ b44 : 352|8@1+ (1,0) [0|255] ""  SRC
 SG_ b45 : 360|8@1+ (1,0) [0|255] ""  SRC
 SG_ b46 : 368|8@1+ (1,0) [0|255] ""  SRC
 SG_ b47 : 376|8@1+ (1,0) [0|255] ""  SRC
 SG_ b48 : 384|8@1+ (1,0) [0|255] ""  SRC
 SG_ b49 : 392|8@1+ (1,0) [0|255] ""  SRC
 SG_ b50 : 400|8@1+ (1,0) [0|255] ""  SRC
 SG_ b51 : 408|8@1+ (1,0) [0|255] ""  SRC
 SG_ b52 : 416|8@1+ (1,0) [0|255] ""  SRC
 SG_ b53 : 424|8@1+ (1,0) [0|255] ""  SRC
 SG_ b54 : 432|8@1+ (1,0) [0|255] ""  SRC
 SG_ b55 : 440|8@1+ (1,0) [0|255] ""  SRC
 SG_ b56 : 448|8@1+ (1,0) [0|255] ""  SRC
 SG_ b57 : 456|8@1+ (1,0) [0|255] ""  SRC
 SG_ b58 : 464|8@1+ (1,0) [0|255] ""  SRC
 SG_ b59 : 472|8@1+ (1,0) [0|255] ""  SRC
 SG_ b60 : 480|8@1+ (1,0) [0|255] ""  SRC
 SG_ b61 : 488|8@1+ (1,0) [0|255] ""  SRC
 SG_ b62 : 496|8@1+ (1,0) [0|255] ""  SRC
 SG_ b63 : 504|8@1+ (1,0) [0|255] ""  SRC

BO_ 112 SERVICE_RESP: 64 SRC
 SG_ b00 : 0|8@1+ (1,0) [0|255] ""  TK
 SG_ b01 : 8|8@1+ (1,0) [0|255] ""  TK
 SG_ b02 : 16|8@1+ (1,0) [0|255] ""  TK
 SG_ b03 : 24|8@1+ (1,0) [0|255] ""  TK
 SG_ b04 : 32|8@1+ (1,0) [0|255] ""  TK
 SG_ b05 : 40|8@1+ (1,0) [0|255] ""  TK
 SG_ b06 : 48|8@1+ (1,0) [0|255] ""  TK
 SG_ b07 : 56|8@1+ (1,0) [0|255] ""  TK
 SG_ b08 : 64|8@1+ (1,0) [0|255] ""  TK
 SG_ b09 : 72|8@1+ (1,0) [0|255] ""  TK
 SG_ b10 : 80|8@1+ (1,0) [0|255] ""  TK
 SG_ b11 : 88|8@1+ (1,0) [0|255] ""  TK
 SG_ b12 : 96|8@1+ (1,0) [0|255] ""  TK
 SG_ b13 : 104|8@1+ (1,0) [0|255] ""  TK
 SG_ b14 : 112|8@1+ (1,0) [0|255] ""  TK
 SG_ b15 : 120|8@1+ (1,0) [0|255] ""  TK
 SG_ b16 : 128|8@1+ (1,0) [0|255] ""  TK
 SG_ b17 : 136|8@1+ (1,0) [0|255] ""  TK
 SG_ b18 : 144|8@1+ (1,0) [0|255] ""  TK
 SG_ b19 : 152|8@1+ (1,0) [0|255] ""  TK
 SG_ b20 : 160|8@1+ (1,0) [0|255] ""  TK
 SG_ b21 : 168|8@1+ (1,0) [0|255] ""  TK
 SG_ b22 : 176|8@1+ (1,0) [0|255] ""  TK
 SG_ b23 : 184|8@1+ (1,0) [0|255] ""  TK
 SG_ b24 : 192|8@1+ (1,0) [0|255] ""  TK
 SG_ b25 : 200|8@1+ (1,0) [0|255] ""  TK
 SG_ b26 : 208|8@1+ (1,0) [0|255] ""  TK
 SG_ b27 : 216|8@1+ (1,0) [0|255] ""  TK
 SG_ b28 : 224|8@1+ (1,0) [0|255] ""  TK
 SG_ b29 : 232|8@1+ (1,0) [0|255] ""  TK
 SG_ b30 : 240|8@1+ (1,0) [0|255] ""  TK
 SG_ b31 : 248|8@1+ (1,0) [0|255] ""  TK
 SG_ b32 : 256|8@1+ (1,0) [0|255] ""  TK
 SG_ b33 : 264|8@1+ (1,0) [0|255] ""  TK
 SG_ b34 : 272|8@1+ (1,0) [0|255] ""  TK
 SG_ b35 : 280|8@1+ (1,0) [0|255] ""  TK
 SG_ b36 : 288|8@1+ (1,0) [0|255] ""  TK
 SG_ b37 : 296|8@1+ (1,0) [0|255] ""  TK
 SG_ b38 : 304|8@1+ (1,0) [0|255] ""  TK
 SG_ b39 : 312|8@1+ (1,0) [0|255] ""  TK
 SG_ b40 : 320|8@1+ (1,0) [0|255] ""  TK
 SG_ b41 : 328|8@1+ (1,0) [0|255] ""  TK
 SG_ b42 : 336|8@1+ (1,0) [0|255] ""  TK
 SG_ b43 : 344|8@1+ (1,0) [0|255] ""  TK
 SG_ b44 : 352|8@1+ (1,0) [0|255] ""  TK
 SG_ b45 : 360|8@1+ (1,0) [0|255] ""  TK
 SG_ b46 : 368|8@1+ (1,0) [0|255] ""  TK
 SG_ b47 : 376|8@1+ (1,0) [0|255] ""  TK
 SG_ b48 : 384|8@1+ (1,0) [0|255] ""  TK
 SG_ b49 : 392|8@1+ (1,0) [0|255] ""  TK
 SG_ b50 : 400|8@1+ (1,0) [0|255] ""  TK
 SG_ b51 : 408|8@1+ (1,0) [0|255] ""  TK
 SG_ b52 : 416|8@1+ (1,0) [0|255] ""  TK
 SG_ b53 : 424|8@1+ (1,0) [0|255] ""  TK
 SG_ b54 : 432|8@1+ (1,0) [0|255] ""  TK
 SG_ b55 : 440|8@1+ (1,0) [0|255] ""  TK
 SG_ b56 : 448|8@1+ (1,0) [0|255] ""  TK
 SG_ b57 : 456|8@1+ (1,0) [0|255] ""  TK
 SG_ b58 : 464|8@1+ (1,0) [0|255] ""  TK
 SG_ b59 : 472|8@1+ (1,0) [0|255] ""  TK
 SG_ b60 : 480|8@1+ (1,0) [0|255] ""  TK
 SG_ b61 : 488|8@1+ (1,0) [0|255] ""  TK
 SG_ b62 : 496|8@1+ (1,0) [0|255] ""  TK
 SG_ b63 : 504|8@1+ (1,0) [0|255] ""  TK
